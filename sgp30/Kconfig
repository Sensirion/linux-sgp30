## sgp30/Kconfig
```kconfig
# Embed the config section into $KERNELDIR/drivers/iio/chemical/Kconfig

config SENSIRION_SGP30
	tristate "Sensirion SGP gas sensors"
	depends on I2C
	select CRC8
	help
	  Say Y here to build I2C interface support for the following
	  Sensirion SGP gas sensors:
	    * SGP30 gas sensor
	    * SGPC3 low power gas sensor

	  To compile this driver as module, choose M here: the
	  module will be called sgp30.
```
